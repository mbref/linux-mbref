## arch/microblaze/Kconfig
```kconfig
# For a description of the syntax of this configuration file,
# see Documentation/kbuild/kconfig-language.txt.

mainmenu "Linux/Microblaze Kernel Configuration"

config MICROBLAZE
	def_bool y

config MMU
	def_bool n

config SWAP
	def_bool n

config RWSEM_GENERIC_SPINLOCK
	def_bool y

config RWSEM_XCHGADD_ALGORITHM
	bool

config ARCH_HAS_ILOG2_U32
	def_bool n

config ARCH_HAS_ILOG2_U64
	def_bool n

config GENERIC_FIND_NEXT_BIT
	def_bool y

config GENERIC_HWEIGHT
	def_bool y

config GENERIC_HARDIRQS
	def_bool y

config GENERIC_IRQ_PROBE
	def_bool y

config GENERIC_CALIBRATE_DELAY
	def_bool y

config GENERIC_TIME
	def_bool y

config PCI
	def_bool n

config NO_DMA
	def_bool y

config GENERIC_CSUM
	def_bool y

config UID16
	def_bool y

config HZ
	int
	default 100

config DEFCONFIG_LIST
	string
	default "arch/$ARCH/defconfig"

source "init/Kconfig"

source "arch/microblaze/platform/Kconfig.platform"

menu "Processor type and features"

config PREEMPT
	bool "Preemptible Kernel"
	help
	  This option reduces the latency of the kernel when reacting to
	  real-time or interactive events by allowing a low priority process to
	  be preempted even if it is in kernel mode executing a system call.
	  This allows applications to run more reliably even when the system is
	  under load.

	  Say Y here if you are building a kernel for a desktop, embedded
	  or real-time system.  Say N if you are unsure.

config PREEMPT_TIMES
	bool "Collect preemption latency times"
	depends on PREEMPT
	help
	  Allow collection for preemption latency times.

config LARGE_ALLOCS
	bool "Allow allocating large blocks (> 1MB) of memory"
	help
	  Allow the slab memory allocator to keep chains for very large
	  memory sizes - up to 32MB. You may need this if your system has
	  a lot of RAM, and you need to able to allocate very large
	  contiguous chunks. If unsure, say N.

comment "Boot options"

config CMDLINE
	string "Default kernel command string"
	default ""
	help
	  On some architectures there is currently no way for the boot loader
	  to pass arguments to the kernel. For these architectures, you should
	  supply some command-line options at build time by entering them
	  here.

config CMDLINE_FORCE
	bool "Force default kernel command string"
	help
	  Set this to have arguments from the default kernel command string
	  override those passed by the boot loader.

config OF
	def_bool y

config OF_DEVICE
	def_bool y

config PROC_DEVICETREE
	bool "Support for device tree in /proc"
	depends on PROC_FS
	help
	  This option adds a device-tree directory under /proc which contains
	  an image of the device tree that the kernel copies from Open
	  Firmware or other boot firmware. If unsure, say Y here.

endmenu

config APM_EMULATION
	bool

source "mm/Kconfig"

menu "Exectuable file formats"

source "fs/Kconfig.binfmt"

endmenu

source "net/Kconfig"

source "drivers/Kconfig"

source "fs/Kconfig"

source "arch/microblaze/Kconfig.debug"

source "security/Kconfig"

source "crypto/Kconfig"

source "lib/Kconfig"
```

## arch/microblaze/Kconfig.debug
```kconfig
# For a description of the syntax of this configuration file,
# see Documentation/kbuild/kconfig-language.txt.

menu "Kernel hacking"

source "lib/Kconfig.debug"

config EARLY_PRINTK
	bool "Early printk function for kernel"
	default n
	help
	  This option turns on/off early printk messages to console.

config EARLY_PRINTK_UARTLITE_ADDRESS
	hex "Physical address where UART Lite for early printk is mapped"
	depends on EARLY_PRINTK
	default "0x00000000"
	help
	  Please enter physical address where your uart lite is mapped.

config HEART_BEAT
	bool "Heart beat function for kernel"
	default n
	help
	  This option turns on/off heart beat kernel functionality on selected
	  GPIO address.

config HEART_BEAT_ADDRESS
	hex "Physical address for heart beat LED"
	depends on HEART_BEAT
	default "0x00000000"
	help
	  Please enter physical address GPIO LED.

config DEBUG_BOOTMEM
	depends on DEBUG_KERNEL
	bool "Debug BOOTMEM initialization"

endmenu
```

## drivers/platform/Kconfig
```kconfig
# drivers/platform/Kconfig

if X86
source "drivers/platform/x86/Kconfig"
endif

menuconfig PLATFORM_DEVICES
	bool "Platform Specific Device Drivers"
	default y
	---help---
	  Say Y here to get to see options for device drivers for various
	  platforms. This option alone does not add any kernel code.

	  If you say N, all options in this submenu will be skipped and disabled.

if PLATFORM_DEVICES

config ML605
	tristate "Support for the Xilinx ML605 FPGA development board"
	depends on I2C_XILINX && SPI_XILINX

endif # PLATFORM_DEVICES
```
